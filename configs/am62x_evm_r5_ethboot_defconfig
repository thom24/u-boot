## configs/am62x_evm_r5_ethboot_defconfig
```kconfig
#include <configs/am62x_evm_r5_defconfig>

CONFIG_SPL_GPIO=y
CONFIG_SPL_BOARD_INIT=y
CONFIG_SPL_STACK_R_MALLOC_SIMPLE_LEN=0x200000
CONFIG_SPL_DMA=y
CONFIG_SPL_ENV_SUPPORT=y
CONFIG_SPL_ETH=y
CONFIG_SPL_I2C=y
CONFIG_SPL_NET=y
CONFIG_SPL_NET_VCI_STRING="AM62X U-Boot R5 SPL"
CONFIG_CMD_DHCP=n
CONFIG_SPL_SYSCON=y
CONFIG_DMA_CHANNELS=y
CONFIG_TI_K3_NAVSS_UDMA=y
CONFIG_DM_I2C=y
CONFIG_PHY_TI_DP83867=y
CONFIG_TI_AM65_CPSW_NUSS=y
CONFIG_MMC=n
CONFIG_SPL_MMC=n
CONFIG_SPI=n
CONFIG_SPL_SPI=n
CONFIG_DM_SPI=n
CONFIG_SPL_DM_SPI=n
CONFIG_SPL_SYS_MALLOC=n
CONFIG_SPI_MEM=n
CONFIG_CMD_FAT=n
CONFIG_FS_FAT=n
CONFIG_SPL_FS_FAT=n
CONFIG_MMC_SDHCI=n
CONFIG_MTD=n
CONFIG_CMD_FAT=n
CONFIG_SYS_RELOC_GD_ENV_ADDR=n
CONFIG_SPL_DM_SPI_FLASH=n
CONFIG_SPL_HAS_CUSTOM_MALLOC_START=n
CONFIG_HUSH_PARSER=n
CONFIG_CMD_DFU=n
CONFIG_CMD_GPT=n
CONFIG_SPL_YMODEM_SUPPORT=n
CONFIG_ARCH_FIXUP_FDT_MEMORY=n
CONFIG_SPL_ENV_IS_NOWHERE=n
CONFIG_INPUT=n
CONFIG_ESM_K3=n
```

## configs/am62x_lpsk_a53_defconfig
```kconfig
#include <configs/am62x_evm_a53_defconfig>
CONFIG_DEFAULT_DEVICE_TREE="k3-am62-lp-sk"
CONFIG_SPL_MTD=y
CONFIG_SPL_MTD_LOAD=y
CONFIG_SYS_MTD_U_BOOT_OFFS=0x280000
CONFIG_SPL_NAND_SPI_SUPPORT=y
CONFIG_CMD_MTD=y
CONFIG_SPL_DM_DEVICE_REMOVE=y
CONFIG_DM_MTD=y
CONFIG_MTD_SPI_NAND=y
```

## configs/am62x_lpsk_a53_ethboot_defconfig
```kconfig
#include <configs/am62x_lpsk_a53_defconfig>

CONFIG_SPL_STACK_R_ADDR=0x83000000
CONFIG_SPL_DRIVERS_MISC=y
CONFIG_SPL_BOARD_INIT=y
CONFIG_SPL_DMA=y
CONFIG_SPL_ENV_SUPPORT=y
CONFIG_SPL_ETH=y
CONFIG_SPL_NET=y
CONFIG_SPL_NET_VCI_STRING="AM62X-LPSK U-Boot A53 SPL"
CONFIG_SPL_SYSCON=y
CONFIG_SPL_SPI=n
CONFIG_SPL_MTD_LOAD=n
CONFIG_SPL_NAND_SPI_SUPPORT=n
CONFIG_SPL_DM_DEVICE_REMOVE=n
CONFIG_DM_MTD=n
CONFIG_MTD_SPI_NAND=n
CONFIG_DM_SPI_FLASH=n
CONFIG_SPI=n
CONFIG_DM_SPI=n
CONFIG_CADENCE_QSPI=n
CONFIG_SF_DEFAULT_MODE=0
CONFIG_SPL_DFU_SF=n
CONFIG_DFU=n
CONFIG_DFU_OVER_USB=n
CONFIG_DFU_MMC=n
CONFIG_DFU_RAM=n
CONFIG_DFU_SF=n
```

## configs/am62x_lpsk_r5_defconfig
```kconfig
#include <configs/am62x_evm_r5_defconfig>
CONFIG_DEFAULT_DEVICE_TREE="k3-am62-r5-lp-sk"
CONFIG_SPL_MTD=y
CONFIG_SPL_MTD_LOAD=y
CONFIG_SPL_NAND_SPI_SUPPORT=y
CONFIG_SPL_DM_DEVICE_REMOVE=y
CONFIG_DM_MTD=y
CONFIG_MTD_SPI_NAND=y
```

## configs/am62x_lpsk_r5_ethboot_defconfig
```kconfig
#include<configs/am62x_lpsk_r5_defconfig>

CONFIG_SPL_GPIO=y
CONFIG_SPL_MMC=n
CONFIG_SPL_BOARD_INIT=y
CONFIG_SPL_STACK_R_MALLOC_SIMPLE_LEN=0x200000
CONFIG_SPL_DMA=y
CONFIG_SPL_ENV_SUPPORT=y
CONFIG_SPL_ETH=y
CONFIG_SPL_I2C=y
CONFIG_SPL_NET=y
CONFIG_SPL_NET_VCI_STRING="AM62X-LPSK U-Boot R5 SPL"
CONFIG_CMD_DHCP=y
CONFIG_SPL_SYSCON=y
CONFIG_DMA_CHANNELS=y
CONFIG_TI_K3_NAVSS_UDMA=y
CONFIG_DM_I2C=y
CONFIG_PHY_TI_DP83867=y
CONFIG_TI_AM65_CPSW_NUSS=y
CONFIG_SPL_SPI=n
CONFIG_SPL_MTD_LOAD=n
CONFIG_SPL_NAND_SPI_SUPPORT=n
CONFIG_SPL_DM_DEVICE_REMOVE=n
CONFIG_DM_MTD=n
CONFIG_MTD_SPI_NAND=n
CONFIG_DM_SPI_FLASH=n
CONFIG_SPI=n
CONFIG_DM_SPI=n
CONFIG_CADENCE_QSPI=n
```

## configs/am62x_lpsk_r5_gpmc_defconfig
```kconfig
#include <configs/am62x_lpsk_r5_defconfig>
CONFIG_CMD_MTDPARTS=y
CONFIG_MTDIDS_DEFAULT="nand0=omap2-nand.0"
CONFIG_MTDPARTS_DEFAULT="omap2-nand.0:2m(NAND.tiboot3),2m(NAND.tispl),2m(NAND.tiboot3.backup),4m(NAND.u-boot),256k(NAND.u-boot-env),256k(NAND.u-boot-env.backup),-(NAND.file-system)"
CONFIG_SYS_NAND_BLOCK_SIZE=0x40000
CONFIG_SYS_NAND_PAGE_COUNT=0x40
CONFIG_SYS_NAND_PAGE_SIZE=0x1000
CONFIG_SYS_NAND_OOBSIZE=0x100
CONFIG_SYS_NAND_U_BOOT_OFFS=0x200000
CONFIG_SYS_NAND_MAX_CHIPS=1
CONFIG_SYS_NAND_U_BOOT_LOCATIONS=y
CONFIG_MEMORY=y
CONFIG_SPL_MEMORY=y
CONFIG_TI_GPMC=y
CONFIG_SPL_NAND_SUPPORT=y
CONFIG_SPL_NAND_DRIVERS=y
CONFIG_SPL_NAND_ECC=y
CONFIG_SPL_NAND_BASE=y
CONFIG_SPL_NAND_IDENT=y
CONFIG_SPL_ENV_SUPPORT=y
CONFIG_MTD_RAW_NAND=y
CONFIG_SYS_NAND_SELF_INIT=y
CONFIG_NAND_OMAP_GPMC=y
CONFIG_NAND_OMAP_ELM=y
CONFIG_SPL_NAND_AM33XX_BCH=n
CONFIG_SPL_SPI=n
CONFIG_SPL_MMC=n
CONFIG_SPL_NAND_SPI_SUPPORT=n
```

## configs/am62xsip_evm_a53_defconfig
```kconfig
#include <configs/am62x_evm_a53_defconfig>

CONFIG_ARM=y
CONFIG_ARCH_K3=y
CONFIG_SOC_K3_AM625=y
CONFIG_TARGET_AM625_A53_EVM=y
CONFIG_SYS_MEM_TOP_HIDE=0x4000000
```

## configs/j742s2_evm_r5_defconfig
```kconfig
#include <configs/j784s4_evm_r5_defconfig>

CONFIG_ARM=y
CONFIG_ARCH_K3=y
CONFIG_SOC_K3_J784S4=y
CONFIG_TARGET_J742S2_R5_EVM=y

CONFIG_K3_AVS0=n
CONFIG_DM_PMIC=n
CONFIG_PMIC_TPS65941=n
CONFIG_DM_REGULATOR=n
CONFIG_SPL_DM_REGULATOR=n
CONFIG_DM_REGULATOR_TPS65941=n
CONFIG_SPL_DM_REGULATOR_TPS6287X=n

CONFIG_DEFAULT_DEVICE_TREE="k3-j742s2-r5-evm"
CONFIG_SPL_OF_LIST="k3-j742s2-r5-evm"
```
