// SPDX-License-Identifier: GPL-2.0-or-later
/*
 * Copyright (C) 2024 Texas Instruments Incorporated - https://www.ti.com/
 */

#include "k3-j784s4-ddr.dtsi"

/delete-node/ &memorycontroller2;
/delete-node/ &memorycontroller3;

&main_navss {
	ranges = <0x00 0x00114000 0x00 0x00114000 0x00 0x00000100>, // ctrl_mmr_lpr
		 <0x00 0x02990000 0x00 0x02990000 0x00 0x00004000>, // ddr0 cfg
		 <0x00 0x029b0000 0x00 0x029b0000 0x00 0x00004000>, // ddr1 cfg
		 <0x00 0x02980000 0x00 0x02980000 0x00 0x00000200>, // ss cfg 0
		 <0x00 0x029a0000 0x00 0x029a0000 0x00 0x00000200>, // ss cfg 1
		 <0x00 0x30000000 0x00 0x30000000 0x00 0x0c400000>;
};
